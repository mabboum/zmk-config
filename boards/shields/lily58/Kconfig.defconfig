## boards/shields/lily58/Kconfig.defconfig
```kconfig
if SHIELD_LILY58_LEFT || SHIELD_LILY58_RIGHT

config ZMK_SPLIT
    default y

if ZMK_DISPLAY

config I2C
    default y

config SSD1306
    default y

# Add these lines for Bongo Cat
config LV_USE_ANIMATION
    bool
    default y

config ZMK_WIDGET_BONGO_CAT
    bool
    default y
    select LV_USE_IMG
    select LV_USE_ANIMATION

endif # ZMK_DISPLAY

endif
```

## config/west.yml
```yaml
manifest:
  remotes:
    - name: SamIAm2000
      url-base: https://github.com/SamIAm2000
  projects:
    - name: zmk
      remote: SamIAm2000
      revision: bongo-cat  # Changed to simpler branch
      import: app/west.yml
  self:
    path: config
```
